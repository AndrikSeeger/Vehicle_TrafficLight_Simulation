ASAP2_VERSION 1 41
/begin PROJECT PC_PC_5_ "Generated by ETAS from Project PC_PC_5_"
/begin HEADER "" VERSION "000" PROJECT_NO ASD /end HEADER
/begin MODULE PC_PC_5_ "Generated by ETAS ASCET7 from Project: PC_PC_5_"
/begin IF_DATA E_TARGET
 /begin SOURCE "Task0" 3 /* period */ 10 QP_BLOB 1 /end SOURCE
 /begin TP_BLOB /* programm id */ 2130730421 /* target id */ 7 0 2 0 /end TP_BLOB
/end IF_DATA
/begin MOD_PAR "" VERSION "000" ADDR_EPK 0x0 EPK "" SUPPLIER "ETAS GmbH" CUSTOMER "xxx" CUSTOMER_NO "000" USER "xxx" PHONE_NO "000" ECU "PC" CPU_TYPE "PCx86" NO_OF_INTERFACES 1 /end MOD_PAR
/begin MOD_COMMON "Common definitions" BYTE_ORDER MSB_LAST ALIGNMENT_BYTE 1 ALIGNMENT_WORD 2 ALIGNMENT_LONG 4 ALIGNMENT_FLOAT32_IEEE 4 ALIGNMENT_FLOAT64_IEEE 8 /end MOD_COMMON
/begin MEASUREMENT myCar.myCar.myVehicle.MyTurn_instance.x "" FLOAT32_IEEE esdl_ident 1 100.0 -3.4028234663852886E+38 3.4028234663852886E+38 ECU_ADDRESS 0x0 /end MEASUREMENT
/begin MEASUREMENT myCar.myCar.myVehicle.MyTurn_instance.y "" FLOAT32_IEEE esdl_ident 1 100.0 -3.4028234663852886E+38 3.4028234663852886E+38 ECU_ADDRESS 0x0 /end MEASUREMENT
/begin MEASUREMENT myCar.myCar.myVehicle.MyTurn_instance.bearing "" FLOAT32_IEEE esdl_ident 1 100.0 -3.4028234663852886E+38 3.4028234663852886E+38 ECU_ADDRESS 0x0 /end MEASUREMENT
/begin CHARACTERISTIC myCar.myCar.myVehicle.MyTurn_instance.D "" VALUE 0x0 STANDARD_VALUE_R32 0.0 esdl_ident -3.4028234663852886E+38 3.4028234663852886E+38 /end CHARACTERISTIC
/begin MEASUREMENT myCar.myCar.myVehicle.MyTurn_instance.dpi "" FLOAT32_IEEE esdl_ident 1 100.0 -3.4028234663852886E+38 3.4028234663852886E+38 ECU_ADDRESS 0x0 /end MEASUREMENT
/begin MEASUREMENT myCar.myCar.myVehicle.MyTurn_instance.pi "" FLOAT32_IEEE esdl_ident 1 100.0 -3.4028234663852886E+38 3.4028234663852886E+38 ECU_ADDRESS 0x0 /end MEASUREMENT
/begin CHARACTERISTIC myCar.myCar.myVehicle.BrakeMomentum "" CURVE 0x0 STANDARD_CURVE_R32R32 0.0 esdl_ident -3.4028234663852886E+38 3.4028234663852886E+38
 /begin AXIS_DESCR STD_AXIS NO_INPUT_QUANTITY esdl_ident 6 -3.4028234663852886E+38 3.4028234663852886E+38 /end AXIS_DESCR
/end CHARACTERISTIC
/begin CHARACTERISTIC myCar.myCar.myVehicle.EngineMomentum "" MAP 0x0 STANDARD_MAP_R32R32R32 0.0 esdl_ident -3.4028234663852886E+38 3.4028234663852886E+38
 /begin AXIS_DESCR STD_AXIS NO_INPUT_QUANTITY esdl_ident 6 -3.4028234663852886E+38 3.4028234663852886E+38 /end AXIS_DESCR
 /begin AXIS_DESCR STD_AXIS myCar.myCar.myVehicle.v esdl_ident 6 -3.4028234663852886E+38 3.4028234663852886E+38 /end AXIS_DESCR
/end CHARACTERISTIC
/begin CHARACTERISTIC myCar.myCar.myVehicle.AirFriction "" CURVE 0x0 STANDARD_CURVE_R32R32 0.0 esdl_ident -3.4028234663852886E+38 3.4028234663852886E+38
 /begin AXIS_DESCR STD_AXIS myCar.myCar.myVehicle.v esdl_ident 6 -3.4028234663852886E+38 3.4028234663852886E+38 /end AXIS_DESCR
/end CHARACTERISTIC
/begin CHARACTERISTIC myCar.myCar.myVehicle.Landscape "" CURVE 0x0 STANDARD_CURVE_R32R32 0.0 esdl_ident -3.4028234663852886E+38 3.4028234663852886E+38
 /begin AXIS_DESCR STD_AXIS myCar.myCar.myVehicle.dist esdl_ident 128 -3.4028234663852886E+38 3.4028234663852886E+38 /end AXIS_DESCR
/end CHARACTERISTIC
/begin MEASUREMENT myCar.myCar.myVehicle.h "" FLOAT32_IEEE esdl_ident 1 100.0 -3.4028234663852886E+38 3.4028234663852886E+38 ECU_ADDRESS 0x0 /end MEASUREMENT
/begin MEASUREMENT myCar.myCar.myVehicle.dh "" FLOAT32_IEEE esdl_ident 1 100.0 -3.4028234663852886E+38 3.4028234663852886E+38 ECU_ADDRESS 0x0 /end MEASUREMENT
/begin MEASUREMENT myCar.myCar.myVehicle.ds "" FLOAT32_IEEE esdl_ident 1 100.0 -3.4028234663852886E+38 3.4028234663852886E+38 ECU_ADDRESS 0x0 /end MEASUREMENT
/begin MEASUREMENT myCar.myCar.myVehicle.momentum "" FLOAT32_IEEE esdl_ident 1 100.0 -3.4028234663852886E+38 3.4028234663852886E+38 ECU_ADDRESS 0x0 /end MEASUREMENT
/begin MEASUREMENT myCar.myCar.myVehicle.dist "" FLOAT32_IEEE esdl_ident 1 100.0 -3.4028234663852886E+38 3.4028234663852886E+38 ECU_ADDRESS 0x0 /end MEASUREMENT
/begin CHARACTERISTIC myCar.myCar.myVehicle.TrackSize "" VALUE 0x0 STANDARD_VALUE_R32 0.0 esdl_ident -3.4028234663852886E+38 3.4028234663852886E+38 /end CHARACTERISTIC
/begin MEASUREMENT myCar.myCar.myVehicle.v "" UWORD esdl_f0_01_kmh 1 100.0 0.0 200.0 ECU_ADDRESS 0x0 /end MEASUREMENT
/begin MEASUREMENT myCar.myCar.myVehicle.x "" FLOAT32_IEEE esdl_ident 1 100.0 -3.4028234663852886E+38 3.4028234663852886E+38 ECU_ADDRESS 0x0 /end MEASUREMENT
/begin MEASUREMENT myCar.myCar.myVehicle.y "" FLOAT32_IEEE esdl_ident 1 100.0 -3.4028234663852886E+38 3.4028234663852886E+38 ECU_ADDRESS 0x0 /end MEASUREMENT
/begin MEASUREMENT myCar.myCar.myVehicle.bearing "" FLOAT32_IEEE esdl_ident 1 100.0 -3.4028234663852886E+38 3.4028234663852886E+38 ECU_ADDRESS 0x0 /end MEASUREMENT
/begin MEASUREMENT myCar.myCar.myVehicle.theorAccel "" FLOAT32_IEEE esdl_ident 1 100.0 -3.4028234663852886E+38 3.4028234663852886E+38 ECU_ADDRESS 0x0 /end MEASUREMENT
/begin MEASUREMENT myCar.myCar.myVehicle.v_2 "" FLOAT32_IEEE esdl_ident 1 100.0 -3.4028234663852886E+38 3.4028234663852886E+38 ECU_ADDRESS 0x0 /end MEASUREMENT
/begin MEASUREMENT myCar.myCar.myVehicle.v_3 "" FLOAT32_IEEE esdl_ident 1 100.0 -3.4028234663852886E+38 3.4028234663852886E+38 ECU_ADDRESS 0x0 /end MEASUREMENT
/begin MEASUREMENT myCar.myCar.time "" FLOAT32_IEEE esdl_ident 1 100.0 -3.4028234663852886E+38 3.4028234663852886E+38 ECU_ADDRESS 0x0 /end MEASUREMENT
/begin CHARACTERISTIC myCar.myCar.g "" VALUE 0x0 STANDARD_VALUE_R32 0.0 esdl_ident -3.4028234663852886E+38 3.4028234663852886E+38 /end CHARACTERISTIC
/begin MEASUREMENT resources.CarMessages.v "" UWORD esdl_f0_01_kmh_km2fh 1 100.0 0.0 200.0 ECU_ADDRESS 0x0 /end MEASUREMENT
/begin MEASUREMENT resources.CarMessages.power "" FLOAT32_IEEE esdl_ident 1 100.0 -3.4028234663852886E+38 3.4028234663852886E+38 ECU_ADDRESS 0x0 /end MEASUREMENT
/begin MEASUREMENT resources.CarMessages.brake "" FLOAT32_IEEE esdl_ident 1 100.0 -3.4028234663852886E+38 3.4028234663852886E+38 ECU_ADDRESS 0x0 /end MEASUREMENT
/begin MEASUREMENT resources.CarMessages.steering "" FLOAT32_IEEE esdl_ident 1 100.0 -3.4028234663852886E+38 3.4028234663852886E+38 ECU_ADDRESS 0x0 /end MEASUREMENT
/begin MEASUREMENT resources.CarMessages.bearing "" FLOAT32_IEEE esdl_ident 1 100.0 -3.4028234663852886E+38 3.4028234663852886E+38 ECU_ADDRESS 0x0 /end MEASUREMENT
/begin MEASUREMENT resources.CarMessages.x "" FLOAT32_IEEE esdl_ident_m 1 100.0 -3.4028234663852886E+38 3.4028234663852886E+38 ECU_ADDRESS 0x0 /end MEASUREMENT
/begin MEASUREMENT resources.CarMessages.dist "" FLOAT32_IEEE esdl_ident_m 1 100.0 -3.4028234663852886E+38 3.4028234663852886E+38 ECU_ADDRESS 0x0 /end MEASUREMENT
/begin MEASUREMENT resources.CarMessages.y "" FLOAT32_IEEE esdl_ident_m 1 100.0 -3.4028234663852886E+38 3.4028234663852886E+38 ECU_ADDRESS 0x0 /end MEASUREMENT
/begin MEASUREMENT resources.CarMessages.theorAccel "" FLOAT32_IEEE esdl_ident_a 1 100.0 -3.4028234663852886E+38 3.4028234663852886E+38 ECU_ADDRESS 0x0 /end MEASUREMENT
/begin MEASUREMENT TrafficLight.Flashlight.Rising_instance.oldSignal "" FLOAT32_IEEE esdl_ident 1 100.0 -3.4028234663852886E+38 3.4028234663852886E+38 ECU_ADDRESS 0x0 /end MEASUREMENT
/begin MEASUREMENT TrafficLight.Flashlight.Rising_instance.returnValue "" UBYTE esdl_ident 1 100.0 0 1 ECU_ADDRESS 0x0 BIT_MASK 0x1 /end MEASUREMENT
/begin MEASUREMENT TrafficLight.Flashlight.Timer_instance.timeCounter "" FLOAT64_IEEE esdl_ident 1 100.0 -1.7976931348623157E+308 1.7976931348623157E+308 ECU_ADDRESS 0x0 /end MEASUREMENT
/begin MEASUREMENT resources.TrafficLightMessages.proximity "" FLOAT32_IEEE esdl_ident_m 1 100.0 -3.4028234663852886E+38 3.4028234663852886E+38 ECU_ADDRESS 0x0 /end MEASUREMENT
/begin MEASUREMENT resources.TrafficLightMessages.redLight "" UBYTE esdl_ident 1 100.0 0 1 ECU_ADDRESS 0x0 BIT_MASK 0x1 /end MEASUREMENT
/begin MEASUREMENT resources.TrafficLightMessages.yellowLight "" UBYTE esdl_ident 1 100.0 0 1 ECU_ADDRESS 0x0 BIT_MASK 0x1 /end MEASUREMENT
/begin MEASUREMENT resources.TrafficLightMessages.greenLight "" UBYTE esdl_ident 1 100.0 0 1 ECU_ADDRESS 0x0 BIT_MASK 0x1 /end MEASUREMENT
/begin MEASUREMENT resources.TrafficLightMessages.flashLight "" UBYTE esdl_ident 1 100.0 0 1 ECU_ADDRESS 0x0 BIT_MASK 0x1 /end MEASUREMENT
/begin MEASUREMENT Driver.CruiseSpeedControl.brake "" FLOAT32_IEEE esdl_ident 1 100.0 -3.4028234663852886E+38 3.4028234663852886E+38 ECU_ADDRESS 0x0 /end MEASUREMENT
/begin MEASUREMENT Driver.CruiseSpeedControl.power "" FLOAT32_IEEE esdl_ident 1 100.0 -3.4028234663852886E+38 3.4028234663852886E+38 ECU_ADDRESS 0x0 /end MEASUREMENT
/begin CHARACTERISTIC Driver.CruiseSpeedControl.AirFriction "" CURVE 0x0 STANDARD_CURVE_R32R32 0.0 esdl_ident -3.4028234663852886E+38 3.4028234663852886E+38
 /begin AXIS_DESCR STD_AXIS NO_INPUT_QUANTITY esdl_ident 6 -3.4028234663852886E+38 3.4028234663852886E+38 /end AXIS_DESCR
/end CHARACTERISTIC
/begin CHARACTERISTIC Driver.CruiseSpeedControl.BrakePedal "" CURVE 0x0 STANDARD_CURVE_R32R32 0.0 esdl_ident -3.4028234663852886E+38 3.4028234663852886E+38
 /begin AXIS_DESCR STD_AXIS NO_INPUT_QUANTITY esdl_ident 6 -3.4028234663852886E+38 3.4028234663852886E+38 /end AXIS_DESCR
/end CHARACTERISTIC
/begin MEASUREMENT Driver.DrivingDecision.anhalteweg "" FLOAT32_IEEE esdl_ident 1 100.0 -3.4028234663852886E+38 3.4028234663852886E+38 ECU_ADDRESS 0x0 /end MEASUREMENT
/begin MEASUREMENT Driver.DrivingDecision.lastStateBreaking "" UBYTE esdl_ident 1 100.0 0 1 ECU_ADDRESS 0x0 BIT_MASK 0x1 /end MEASUREMENT
/begin MEASUREMENT TrafficLight.TrafficLight.StopWatch_instance.timeCounter "" FLOAT64_IEEE esdl_ident 1 100.0 -1.7976931348623157E+308 1.7976931348623157E+308 ECU_ADDRESS 0x0 /end MEASUREMENT
/begin MEASUREMENT TrafficLight.TrafficLight.red "" UBYTE esdl_ident 1 100.0 0 1 ECU_ADDRESS 0x0 BIT_MASK 0x1 /end MEASUREMENT
/begin MEASUREMENT TrafficLight.TrafficLight.yellow "" UBYTE esdl_ident 1 100.0 0 1 ECU_ADDRESS 0x0 BIT_MASK 0x1 /end MEASUREMENT
/begin MEASUREMENT TrafficLight.TrafficLight.green "" UBYTE esdl_ident 1 100.0 0 1 ECU_ADDRESS 0x0 BIT_MASK 0x1 /end MEASUREMENT
/begin MEASUREMENT Driver.DecelerationControl.oldSpeed "" FLOAT32_IEEE esdl_ident 1 100.0 -3.4028234663852886E+38 3.4028234663852886E+38 ECU_ADDRESS 0x0 /end MEASUREMENT
/begin MEASUREMENT Driver.DecelerationControl.accel "" FLOAT32_IEEE esdl_ident 1 100.0 -3.4028234663852886E+38 3.4028234663852886E+38 ECU_ADDRESS 0x0 /end MEASUREMENT
/begin CHARACTERISTIC Driver.DecelerationControl.AirFriction "" CURVE 0x0 STANDARD_CURVE_R32R32 0.0 esdl_ident -3.4028234663852886E+38 3.4028234663852886E+38
 /begin AXIS_DESCR STD_AXIS resources.CarMessages.v esdl_ident 6 -3.4028234663852886E+38 3.4028234663852886E+38 /end AXIS_DESCR
/end CHARACTERISTIC
/begin MEASUREMENT Driver.DecelerationControl.accBelowLimit "" UBYTE esdl_ident 1 100.0 0 1 ECU_ADDRESS 0x0 BIT_MASK 0x1 /end MEASUREMENT
/begin CHARACTERISTIC Driver.DecelerationControl.BrakeMomentum "" CURVE 0x0 STANDARD_CURVE_R32R32 0.0 esdl_ident -3.4028234663852886E+38 3.4028234663852886E+38
 /begin AXIS_DESCR STD_AXIS resources.CarMessages.brake esdl_ident 6 -3.4028234663852886E+38 3.4028234663852886E+38 /end AXIS_DESCR
/end CHARACTERISTIC
/begin MEASUREMENT Driver.DecelerationControl.accBelowLimitCalc "" UBYTE esdl_ident 1 100.0 0 1 ECU_ADDRESS 0x0 BIT_MASK 0x1 /end MEASUREMENT
/begin MEASUREMENT Driver.DecelerationControl.accelCalc "" FLOAT32_IEEE esdl_ident 1 100.0 -3.4028234663852886E+38 3.4028234663852886E+38 ECU_ADDRESS 0x0 /end MEASUREMENT
/begin MEASUREMENT Driver.DecelerationControl.accBelowLimitReal "" UBYTE esdl_ident 1 100.0 0 1 ECU_ADDRESS 0x0 BIT_MASK 0x1 /end MEASUREMENT
/begin MEASUREMENT Driver.DecelerationControl.carAccel "" FLOAT32_IEEE esdl_ident 1 100.0 -3.4028234663852886E+38 3.4028234663852886E+38 ECU_ADDRESS 0x0 /end MEASUREMENT
/begin COMPU_METHOD esdl_f0_01_kmh "" RAT_FUNC "%12.4" "" COEFFS 0 100 0 0 0 1 /end COMPU_METHOD
/begin COMPU_METHOD esdl_f0_01_kmh_km2fh "" RAT_FUNC "%12.4" "km/h" COEFFS 0 100 0 0 0 1 /end COMPU_METHOD
/begin COMPU_METHOD esdl_ident "" RAT_FUNC "%12.4" "" COEFFS 0 1 0 0 0 1 /end COMPU_METHOD
/begin COMPU_METHOD esdl_ident_a "" RAT_FUNC "%12.4" "a" COEFFS 0 1 0 0 0 1 /end COMPU_METHOD
/begin COMPU_METHOD esdl_ident_m "" RAT_FUNC "%12.4" "m" COEFFS 0 1 0 0 0 1 /end COMPU_METHOD
/begin FUNCTION myCar.myCar "" /begin DEF_CHARACTERISTIC myCar.myCar.g /end DEF_CHARACTERISTIC
 /begin IN_MEASUREMENT resources.CarMessages.brake resources.CarMessages.power resources.CarMessages.steering /end IN_MEASUREMENT
 /begin OUT_MEASUREMENT resources.CarMessages.bearing resources.CarMessages.dist resources.CarMessages.theorAccel resources.CarMessages.v resources.CarMessages.x resources.CarMessages.y /end OUT_MEASUREMENT
 /begin LOC_MEASUREMENT myCar.myCar.time /end LOC_MEASUREMENT
 /begin SUB_FUNCTION myCar.myCar.myVehicle /end SUB_FUNCTION
/end FUNCTION
/begin FUNCTION myCar.myCar.myVehicle ""
 /begin DEF_CHARACTERISTIC myCar.myCar.myVehicle.BrakeMomentum myCar.myCar.myVehicle.EngineMomentum myCar.myCar.myVehicle.AirFriction myCar.myCar.myVehicle.Landscape myCar.myCar.myVehicle.TrackSize /end DEF_CHARACTERISTIC
 /begin LOC_MEASUREMENT myCar.myCar.myVehicle.bearing myCar.myCar.myVehicle.dh myCar.myCar.myVehicle.dist myCar.myCar.myVehicle.ds myCar.myCar.myVehicle.h myCar.myCar.myVehicle.momentum myCar.myCar.myVehicle.theorAccel myCar.myCar.myVehicle.v myCar.myCar.myVehicle.v_2 myCar.myCar.myVehicle.v_3 myCar.myCar.myVehicle.x myCar.myCar.myVehicle.y /end LOC_MEASUREMENT
 /begin SUB_FUNCTION myCar.myCar.myVehicle.MyTurn_instance /end SUB_FUNCTION
/end FUNCTION
/begin FUNCTION myCar.myCar.myVehicle.MyTurn_instance "" /begin DEF_CHARACTERISTIC myCar.myCar.myVehicle.MyTurn_instance.D /end DEF_CHARACTERISTIC
 /begin LOC_MEASUREMENT myCar.myCar.myVehicle.MyTurn_instance.bearing myCar.myCar.myVehicle.MyTurn_instance.dpi myCar.myCar.myVehicle.MyTurn_instance.pi myCar.myCar.myVehicle.MyTurn_instance.x myCar.myCar.myVehicle.MyTurn_instance.y /end LOC_MEASUREMENT
 /begin SUB_FUNCTION myCar.myCar.myVehicle.MyTurn_instance.Lib /end SUB_FUNCTION
/end FUNCTION
/begin FUNCTION myCar.myCar.myVehicle.MyTurn_instance.Lib "MathLib is a C code class that returns the results of numerous mathematical functions." /end FUNCTION
/begin FUNCTION TrafficLight.Flashlight ""
 /begin IN_MEASUREMENT resources.TrafficLightMessages.proximity resources.TrafficLightMessages.redLight /end IN_MEASUREMENT
 /begin OUT_MEASUREMENT resources.TrafficLightMessages.flashLight /end OUT_MEASUREMENT
 /begin SUB_FUNCTION TrafficLight.Flashlight.Rising_instance TrafficLight.Flashlight.Timer_instance /end SUB_FUNCTION
/end FUNCTION
/begin FUNCTION TrafficLight.Flashlight.Rising_instance ""
 /begin LOC_MEASUREMENT TrafficLight.Flashlight.Rising_instance.oldSignal TrafficLight.Flashlight.Rising_instance.returnValue /end LOC_MEASUREMENT
/end FUNCTION
/begin FUNCTION TrafficLight.Flashlight.Timer_instance "Timer decrements the time counter by dT and signals when the time counter has reached zero. It is not retriggerable." /begin LOC_MEASUREMENT TrafficLight.Flashlight.Timer_instance.timeCounter /end LOC_MEASUREMENT /end FUNCTION
/begin FUNCTION Driver.CruiseSpeedControl ""
 /begin DEF_CHARACTERISTIC Driver.CruiseSpeedControl.AirFriction Driver.CruiseSpeedControl.BrakePedal /end DEF_CHARACTERISTIC
 /begin LOC_MEASUREMENT Driver.CruiseSpeedControl.brake Driver.CruiseSpeedControl.power /end LOC_MEASUREMENT
/end FUNCTION
/begin FUNCTION Driver.DrivingDecision ""
 /begin IN_MEASUREMENT resources.CarMessages.v resources.TrafficLightMessages.proximity resources.TrafficLightMessages.redLight resources.TrafficLightMessages.yellowLight /end IN_MEASUREMENT
 /begin OUT_MEASUREMENT resources.CarMessages.brake resources.CarMessages.power /end OUT_MEASUREMENT
 /begin LOC_MEASUREMENT Driver.DrivingDecision.anhalteweg Driver.DrivingDecision.lastStateBreaking /end LOC_MEASUREMENT
/end FUNCTION
/begin FUNCTION TrafficLight.TrafficLight "" /begin IN_MEASUREMENT resources.CarMessages.dist /end IN_MEASUREMENT
 /begin OUT_MEASUREMENT resources.TrafficLightMessages.greenLight resources.TrafficLightMessages.proximity resources.TrafficLightMessages.redLight resources.TrafficLightMessages.yellowLight /end OUT_MEASUREMENT
 /begin LOC_MEASUREMENT TrafficLight.TrafficLight.green TrafficLight.TrafficLight.red TrafficLight.TrafficLight.yellow /end LOC_MEASUREMENT
 /begin SUB_FUNCTION TrafficLight.TrafficLight.StopWatch_instance TrafficLight.TrafficLight.TrafficLightPositionModel_instance /end SUB_FUNCTION
/end FUNCTION
/begin FUNCTION TrafficLight.TrafficLight.StopWatch_instance "StopWatch increments the time counter by one dT." /begin LOC_MEASUREMENT TrafficLight.TrafficLight.StopWatch_instance.timeCounter /end LOC_MEASUREMENT /end FUNCTION
/begin FUNCTION TrafficLight.TrafficLight.TrafficLightPositionModel_instance "" /end FUNCTION
/begin FUNCTION Driver.DecelerationControl ""
 /begin DEF_CHARACTERISTIC Driver.DecelerationControl.AirFriction Driver.DecelerationControl.BrakeMomentum /end DEF_CHARACTERISTIC
 /begin IN_MEASUREMENT resources.CarMessages.brake resources.CarMessages.theorAccel resources.CarMessages.v /end IN_MEASUREMENT
 /begin LOC_MEASUREMENT Driver.DecelerationControl.accBelowLimit Driver.DecelerationControl.accBelowLimitCalc Driver.DecelerationControl.accBelowLimitReal Driver.DecelerationControl.accel Driver.DecelerationControl.accelCalc Driver.DecelerationControl.carAccel Driver.DecelerationControl.oldSpeed /end LOC_MEASUREMENT
/end FUNCTION
/begin FUNCTION SystemLib.Miscellaneous.DeltaTimeService "Provides the delta time variable" /end FUNCTION
/begin RECORD_LAYOUT STANDARD_CURVE_R32R32 /* axis size */ NO_AXIS_PTS_X 1 UWORD /* axis */ AXIS_PTS_X 2 FLOAT32_IEEE INDEX_INCR DIRECT FNC_VALUES 3 FLOAT32_IEEE COLUMN_DIR DIRECT /end RECORD_LAYOUT
/begin RECORD_LAYOUT STANDARD_MAP_R32R32R32 /* x axis size */ NO_AXIS_PTS_X 1 UWORD /* y axis size */ NO_AXIS_PTS_Y 2 UWORD /* x axis */ AXIS_PTS_X 3 FLOAT32_IEEE INDEX_INCR DIRECT /* y axis */ AXIS_PTS_Y 4 FLOAT32_IEEE INDEX_INCR DIRECT FNC_VALUES 5 FLOAT32_IEEE COLUMN_DIR DIRECT /end RECORD_LAYOUT
/begin RECORD_LAYOUT STANDARD_VALUE_R32 FNC_VALUES 1 FLOAT32_IEEE COLUMN_DIR DIRECT /end RECORD_LAYOUT
/begin GROUP Driver.CruiseSpeedControl "" ROOT
 /begin REF_CHARACTERISTIC Driver.CruiseSpeedControl.AirFriction Driver.CruiseSpeedControl.BrakePedal /end REF_CHARACTERISTIC
 /begin REF_MEASUREMENT Driver.CruiseSpeedControl.brake Driver.CruiseSpeedControl.power /end REF_MEASUREMENT
/end GROUP
/begin GROUP Driver.DecelerationControl "" ROOT
 /begin REF_CHARACTERISTIC Driver.DecelerationControl.AirFriction Driver.DecelerationControl.BrakeMomentum /end REF_CHARACTERISTIC
 /begin REF_MEASUREMENT Driver.DecelerationControl.accBelowLimit Driver.DecelerationControl.accBelowLimitCalc Driver.DecelerationControl.accBelowLimitReal Driver.DecelerationControl.accel Driver.DecelerationControl.accelCalc Driver.DecelerationControl.carAccel Driver.DecelerationControl.oldSpeed /end REF_MEASUREMENT
/end GROUP
/begin GROUP Driver.DrivingDecision "" ROOT
 /begin REF_MEASUREMENT Driver.DrivingDecision.anhalteweg Driver.DrivingDecision.lastStateBreaking /end REF_MEASUREMENT
/end GROUP
/begin GROUP SystemLib.Miscellaneous.DeltaTimeService "Provides the delta time variable" ROOT /end GROUP
/begin GROUP TrafficLight.Flashlight "" ROOT
 /begin SUB_GROUP TrafficLight.Flashlight.Rising_instance TrafficLight.Flashlight.Timer_instance /end SUB_GROUP
/end GROUP
/begin GROUP TrafficLight.Flashlight.Rising_instance ""
 /begin REF_MEASUREMENT TrafficLight.Flashlight.Rising_instance.oldSignal TrafficLight.Flashlight.Rising_instance.returnValue /end REF_MEASUREMENT
/end GROUP
/begin GROUP TrafficLight.Flashlight.Timer_instance "Timer decrements the time counter by dT and signals when the time counter has reached zero. It is not retriggerable." /begin REF_MEASUREMENT TrafficLight.Flashlight.Timer_instance.timeCounter /end REF_MEASUREMENT /end GROUP
/begin GROUP TrafficLight.TrafficLight "" ROOT
 /begin REF_MEASUREMENT TrafficLight.TrafficLight.green TrafficLight.TrafficLight.red TrafficLight.TrafficLight.yellow /end REF_MEASUREMENT
 /begin SUB_GROUP TrafficLight.TrafficLight.StopWatch_instance TrafficLight.TrafficLight.TrafficLightPositionModel_instance /end SUB_GROUP
/end GROUP
/begin GROUP TrafficLight.TrafficLight.StopWatch_instance "StopWatch increments the time counter by one dT." /begin REF_MEASUREMENT TrafficLight.TrafficLight.StopWatch_instance.timeCounter /end REF_MEASUREMENT /end GROUP
/begin GROUP TrafficLight.TrafficLight.TrafficLightPositionModel_instance "" /end GROUP
/begin GROUP myCar.myCar "" ROOT /begin REF_CHARACTERISTIC myCar.myCar.g /end REF_CHARACTERISTIC /begin REF_MEASUREMENT myCar.myCar.time /end REF_MEASUREMENT /begin SUB_GROUP myCar.myCar.myVehicle /end SUB_GROUP /end GROUP
/begin GROUP myCar.myCar.myVehicle ""
 /begin REF_CHARACTERISTIC myCar.myCar.myVehicle.BrakeMomentum myCar.myCar.myVehicle.EngineMomentum myCar.myCar.myVehicle.AirFriction myCar.myCar.myVehicle.Landscape myCar.myCar.myVehicle.TrackSize /end REF_CHARACTERISTIC
 /begin REF_MEASUREMENT myCar.myCar.myVehicle.bearing myCar.myCar.myVehicle.dh myCar.myCar.myVehicle.dist myCar.myCar.myVehicle.ds myCar.myCar.myVehicle.h myCar.myCar.myVehicle.momentum myCar.myCar.myVehicle.theorAccel myCar.myCar.myVehicle.v myCar.myCar.myVehicle.v_2 myCar.myCar.myVehicle.v_3 myCar.myCar.myVehicle.x myCar.myCar.myVehicle.y /end REF_MEASUREMENT
 /begin SUB_GROUP myCar.myCar.myVehicle.MyTurn_instance /end SUB_GROUP
/end GROUP
/begin GROUP myCar.myCar.myVehicle.MyTurn_instance "" /begin REF_CHARACTERISTIC myCar.myCar.myVehicle.MyTurn_instance.D /end REF_CHARACTERISTIC
 /begin REF_MEASUREMENT myCar.myCar.myVehicle.MyTurn_instance.bearing myCar.myCar.myVehicle.MyTurn_instance.dpi myCar.myCar.myVehicle.MyTurn_instance.pi myCar.myCar.myVehicle.MyTurn_instance.x myCar.myCar.myVehicle.MyTurn_instance.y /end REF_MEASUREMENT
 /begin SUB_GROUP myCar.myCar.myVehicle.MyTurn_instance.Lib /end SUB_GROUP
/end GROUP
/begin GROUP myCar.myCar.myVehicle.MyTurn_instance.Lib "MathLib is a C code class that returns the results of numerous mathematical functions." /end GROUP
/begin GROUP resources.CarMessages "" ROOT
 /begin REF_MEASUREMENT resources.CarMessages.bearing resources.CarMessages.brake resources.CarMessages.dist resources.CarMessages.power resources.CarMessages.steering resources.CarMessages.theorAccel resources.CarMessages.v resources.CarMessages.x resources.CarMessages.y /end REF_MEASUREMENT
/end GROUP
/begin GROUP resources.TrafficLightMessages "" ROOT
 /begin REF_MEASUREMENT resources.TrafficLightMessages.flashLight resources.TrafficLightMessages.greenLight resources.TrafficLightMessages.proximity resources.TrafficLightMessages.redLight resources.TrafficLightMessages.yellowLight /end REF_MEASUREMENT
/end GROUP
/end MODULE
/end PROJECT
